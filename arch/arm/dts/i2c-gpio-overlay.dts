/dts-v1/;

/ {
	compatible = "brcm,bcm2708";

	fragment@0 {
		target-path = [2f 00];

		__overlay__ {

			i2c@0 {
				compatible = "i2c-gpio";
				gpios = <0xffffffff 0x17 0x0 0xffffffff 0x18 0x0>;
				i2c-gpio,delay-us = <0x2>;
				#address-cells = <0x1>;
				#size-cells = <0x0>;
				phandle = <0x1>;
			};
		};
	};

	fragment@1 {
		target-path = "/aliases";

		__overlay__ {
			i2c_gpio = "/i2c@0";
		};
	};

	fragment@2 {
		target-path = "/__symbols__";

		__overlay__ {
			i2c_gpio = "/i2c@0";
		};
	};

	__overrides__ {
		i2c_gpio_sda = <0x1 0x6770696f 0x733a3400>;
		i2c_gpio_scl = [00 00 00 01 67 70 69 6f 73 3a 31 36 00];
		i2c_gpio_delay_us = <0x1 0x6932632d 0x6770696f 0x2c64656c 0x61792d75 0x733a3000>;
		bus = [00 00 00 01 72 65 67 3a 30 00];
	};

	__symbols__ {
		i2c_gpio = "/fragment@0/__overlay__/i2c@0";
	};

	__fixups__ {
		gpio = "/fragment@0/__overlay__/i2c@0:gpios:0", "/fragment@0/__overlay__/i2c@0:gpios:12";
	};

	__local_fixups__ {

		__overrides__ {
			i2c_gpio_sda = <0x0>;
			i2c_gpio_scl = <0x0>;
			i2c_gpio_delay_us = <0x0>;
                        interrupt = <28>;
			bus = <0x0>;
		};
	};
};
